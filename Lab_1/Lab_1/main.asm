;*******************************************************************************************************************************
;Universidad del valle
;Prelab_1.asm
;Autor: Albert Vandercam Hart
;Hardware ATmega328P
;Creado: 31/01/2024
;*******************************************************************************************************************************
; ENCABEZADO
;*******************************************************************************************************************************
.include "M328PDEF.inc"
.CSEG
.ORG 0x0000
;*******************************************************************************************************************************
; STACK POINTER
;*******************************************************************************************************************************
LDI R16, LOW(RAMEND)
OUT SPL,R16
LDI R17, HIGH(RAMEND)
OUT SPH, R17
;*******************************************************************************************************************************
; CONFIGURACI[ON
;*******************************************************************************************************************************
setup:
	LDI R16, (1<<CLKPCE)
	STS CLKPR, R16

	LDI R16, 0b0000_0100
	STS CLKPR, R16


	; ACTIVAR LOS PUERTOS
	;ACTIVAR PUERTOS C
	LDI R16, 0x00
	LDI R16,0b1110_0000 ; CONFIUGURAR SI SON ENTRADA: 1PULL UP, SI ES SALIDA 1 5V
	OUT DDRC, R16 ;SE CONFIGURARON LOS PINES DE OUTPUTS/INPUTS, 1 SALIDA 0  ENTRADA
	LDI R17,0b0001_1111
	OUT PORTC, R17
	; ACTIVAR PUERTOS B
	LDI R16, 0xFF
	LDI R17, 0x00 
	OUT DDRB, R16 ;SE CONFIGURARON LOS PINES DE OUTPUTS/INPUTS 1 SALIDA 0  ENTRADA
	LDI R17, 0x00 ; CONFIUGURAR SI SON ENTRADA: 1PULL UP, SI ES SALIDA 1 5V
	OUT PORTB, R17
	;ACTIVAR PUERTOS D
	LDI R16, 0xFF
	LDI R17, 0x00
	OUT DDRD, R16 ;SE CONFIGURARON LOS PINES DE OUTPUTS/INPUTS 1 SALIDA 0  ENTRADA
	OUT PORTD, R17


MAIN_LOOP:
		IN R16, PINC	
		NOP
		CPI R16, 0x1F
		BRNE DELAY ; SI SON IGUALES REGRESA
		RJMP MAIN_LOOP		
SELECCIONADOR_COMPROBADOR:; LEER SI SE PRECIONA EL BOTÓN DE INCREMENTAR PRIMER CONTADOR
		LDI R16, 0xFF
		NOP
		IN R16,  PINC		
		CPI R16, 0x1E;SI QUIERES RESTAR BOTON 2
		BREQ RESTAR1	; SINO ES IGUAL ENTONCES SIGUE COMPARANDO
		CPI R16, 0x1D ;SI QUIRES SUMAR BOTON 1
		BREQ SUMADOR1	
		CPI R16, 0x1B; SI QUIERES RESTAR BOTON 2
		BREQ RESTAR2	
		CPI R16, 0x17;SI QUERES SUMAR BOTON 2
		BREQ SALTASR2
		CPI R16, 0x0F;SI QUIERES SUMAR LOS DOS CONTADORES
		 BREQ SJUMP
		RJMP MAIN_LOOP
SALTASR2:
	RJMP SUMADOR2
SJUMP:
	RJMP SUMADOR
DELAY: 
	LDI R17, 254
LOOP_DELAY:
	DEC R17
	BRNE LOOP_DELAY
	RJMP SELECCIONADOR_COMPROBADOR
RESTAR1:
	IN R16, PINC
	SBRS R16, PC0 ; SI EL BIT NO ES 1 ENTONCES QUE REGRESE AL RESTAR1
	RJMP RESTAR1
	CPI R18, 0x00; QUE EL NÚMERO NO SEA 0
	BREQ MAIN_LOOP ; SI EL NUMERO ES 0 REGRESAR AL LOOP PRINCIPAL
	DEC R18
	CBI PORTB, PB0
	CBI PORTB, PB1
	CBI PORTB, PB2
	CBI PORTB, PB3
	SBRC  R18, 0
	SBI PORTB, PB0
	SBRC  R18, 1
	SBI PORTB, PB1
	SBRC  R18, 2
	SBI PORTB, PB2
	SBRC  R18, 3
	SBI PORTB, PB3
	RJMP  MAIN_LOOP
SUMADOR1:
	IN R16, PINC
	SBRS R16, PC1
	RJMP SUMADOR1
	CPI R18, 0x0F
	BREQ MAIN_LOOP ; SI EL NÚMERO NO ES QUINCE TONCES QUE AVANCE 
	INC R18
	CBI PORTB, PB0
	CBI PORTB, PB1
	CBI PORTB, PB2
	CBI PORTB, PB3
	SBRC  R18, 0
	SBI PORTB, PB0
	SBRC  R18, 1
	SBI PORTB, PB1
	SBRC  R18, 2
	SBI PORTB, PB2
	SBRC  R18, 3
	SBI PORTB, PB3
	RJMP MAIN_LOOP
RESTAR2:
	IN R16, PINC
	SBRS R16, PC2
	RJMP RESTAR2
	CPI R19, 0x00; QUE EL NÚMERO NO SEA 0
	BREQ SALTAR ; SI EL NUMERO ES 0 REGRESAR AL LOOP PRINCIPAL
	DEC R19
	CBI PORTD, PD4
	CBI PORTD, PD5
	CBI PORTD, PD6
	CBI PORTD, PD7
	SBRC  R19, 0
	SBI PORTD, PD4
	SBRC  R19, 1
	SBI PORTD, PD5
	SBRC  R19, 2
	SBI PORTD, PD6
	SBRC  R19, 3
	SBI PORTB, PD7
	RJMP  MAIN_LOOP
SUMADOR2:
	IN R16, PINC
	SBRS R16, PC3
	RJMP SUMADOR2
	CPI R19, 0x0F
	BREQ SALTAR ; SI EL NÚMERO NO ES QUINCE TONCES QUE AVANCE 
	INC R19
	CBI PORTD, PD4
	CBI PORTD, PD5
	CBI PORTD, PD6
	CBI PORTD, PD7
	SBRC  R19, 0
	SBI PORTD, PD4
	SBRC  R19, 1
	SBI PORTD, PD5
	SBRC  R19, 2
	SBI PORTD, PD6
	SBRC  R19, 3
	SBI PORTD, PD7
	RJMP MAIN_LOOP
SUMADOR:
	 IN R16, PINC ; ESTO HACE QUE HASTA QUE EL USUARIO DEJE DE PREIOSNAR EL BOTÓN FUNCIONE
	
	; AQUÍ APGAMOS TODOS LOS BITS DEL RESULTADO
	CBI PORTD, PD2
	CBI PORTD,  PD3
	CBI PORTB, PB5
	CBI PORTB, PD4
	SBRS R16, PC4
	RJMP SUMADOR
	CPI R19, 0x0F;AQUÍ TERMINA LA VERIFICACIÓN
	MOV R21, R18
	ADD R21, R19
    CPI R21,  0x1F
	BRSH  SALTAR
	;SE COMPARA PARA VER SI SE TIENE QUE PRENDER EL BIT EN ESPECÍFICO O SI SIGUE EN 0
	SBRC R21, 0
	SBI PORTD, PD2
	SBRC R21, 1
	SBI PORTD,  PD3
	SBRC R21, 2
	SBI PORTB, PB5
	SBRC R21, 3
	SBI PORTB, PB4
	RJMP MAIN_LOOP
SALTAR:
	RJMP MAIN_LOOP



	